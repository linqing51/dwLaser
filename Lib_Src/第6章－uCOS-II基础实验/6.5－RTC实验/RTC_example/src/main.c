/****************************************Copyright (c)**************************************************
**                               Guangzou ZLG-MCU Development Co.,LTD.
**                                      graduate school
**                                 http://www.zlgmcu.com
**
**--------------File Info-------------------------------------------------------------------------------
** File name:			main.c
** Last modified Date:  2004-09-16
** Last Version:		1.0
** Descriptions:		The main() function example template
**
**------------------------------------------------------------------------------------------------------
** Created by:			Chenmingji
** Created date:		2004-09-16
** Version:				1.0
** Descriptions:		The original version
**
**------------------------------------------------------------------------------------------------------
** Modified by:
** Modified date:
** Version:
** Descriptions:
**
********************************************************************************************************/
/****************************************Copyright (c)**************************************************
**                               广州周立功单片机发展有限公司
**                                     研    究    所
**                                        产品一部 
**
**                                 http://www.zlgmcu.com
**
**--------------文件信息--------------------------------------------------------------------------------
**文   件   名: test.c
**创   建   人: 陈明计
**最后修改日期: 2003年7月8日
**描        述: LPC2114的实时时钟使用在μCOS-II示例。通过UART0将显示数据发送到上位机，上位机运行EasyARM软件，在全
**             仿真DOS字符窗口上显示当前时间，按下EasyARM2100开发实验板上的KEY1则重新设置时间--年加1、时加1。
**--------------历史版本信息----------------------------------------------------------------------------
** 创建人: 陈明计
** 版  本: v1.0
** 日　期: 2003年7月8日
** 描　述: 原始版本
**
**--------------历史版本修订------------------------------------------------------------------------------
** 修改人: 黄绍斌
** 日　期: 2004年3月25日
** 描　述: 针对EasyARM2100开发实验板进行修改(KEY1的定义及PINSEL1设置)；
**        在config.h文件中加入包含rtc.h，并在TARGET.C文件中初始化UART0。
** 说  明: 将JP5短接，将PC的COM1(或COM2)与EasyARM2100开发板的CZ2连接。
**------------------------------------------------------------------------------------------------------
********************************************************************************************************/
/***--------------当前版本修订------------------------------------------------------------------------------
** 修改人: 黄绍斌
** 日　期: 2005-03-11
** 描　述: 用EasyARM2131模板重新建立工程。
** 说  明: 
**------------------------------------------------------------------------------------------------------
********************************************************************************************************/

#include "config.h"

#define  TASK_STK_SIZE                  64
OS_STK        TaskStartStk[TASK_STK_SIZE];
OS_STK        TaskStk[TASK_STK_SIZE];

#define	  KEY1	(1 << 16)             /* P0.16为KEY1 */

void  TaskStart(void *data);
void  Task(void *data);
/*********************************************************************************************************
** 函数名称: main
** 功能描述: c语言的主函数，由它启动多任务环境
** 输　入: 无
** 输　出: 无
** 全局变量: 无
** 调用模块: OSInit,OSTaskCreate,OSStart
**
** 作　者: 陈明计
** 日　期: 2003年7月8日
**-------------------------------------------------------------------------------------------------------
** 修改人: 
** 日　期: 
**------------------------------------------------------------------------------------------------------
********************************************************************************************************/
        int main (void)
{
    OSInit();

    OSTaskCreate(TaskStart, (void *)0, &TaskStartStk[TASK_STK_SIZE - 1], 0);
    OSStart();
    return 0;
}

/*********************************************************************************************************
** 函数名称: TaskStart
** 功能描述: μCOS-II的第一个任务，通常由它初始化目标板和建立其它任务
** 输　入: 无
** 输　出: 无
** 全局变量: 无
** 调用模块: 
**
** 作　者: 陈明计
** 日　期: 2003年7月8日
**-------------------------------------------------------------------------------------------------------
** 修改人: 
** 日　期: 
**------------------------------------------------------------------------------------------------------
********************************************************************************************************/

        void  TaskStart(void *pdata)
{
    struct time now;
    struct date today;
    char s[40];

    pdata = pdata;                                                  /* 避免编译警告 */

    TargetInit();                                                   /* 目标板初始化 */
    IO0DIR &= ~KEY1;			                                    /* 设置KEY1为输入*/
    PINSEL1 = (PINSEL1 & 0xfffffffc);                               /* 管脚选择模块初始化 */
    
    OSTaskCreate(Task, (void *)0, &TaskStk[TASK_STK_SIZE - 1], 10); /* 创建任务     */

    for (;;)
    {
        gettime(&now);
        getdate(&today);
        sprintf(s, "%04d-%02d-%02d  %02d:%02d:%02d",
                   today.da_year,
                   today.da_mon,
                   today.da_day,
                   now.ti_hour,
                   now.ti_min,
                   now.ti_sec);
        PC_DispStr(1, 1, s, DISP_FGND_YELLOW + DISP_BGND_BLUE);
        OSTimeDly(OS_TICKS_PER_SEC / 2);
    }
}

/*********************************************************************************************************
** 函数名称: Task
** 功能描述: μCOS-II的任务
** 输　入: 无
** 输　出: 无
** 全局变量: 无
** 调用模块: 
**
** 作　者: 陈明计
** 日　期: 2003年7月8日
**-------------------------------------------------------------------------------------------------------
** 修改人: 陈锡炳
** 日　期: 2005-03-11
**------------------------------------------------------------------------------------------------------
********************************************************************************************************/
/***-------------------------------------------------------------------------------------------------------
** 修改人: 
** 日　期: 
**------------------------------------------------------------------------------------------------------
********************************************************************************************************/
        void  Task(void *pdata)
{
    struct time now;
    struct date today;

    pdata = pdata;                                      /* 避免编译警告 */

    today.da_year = 2005;
    today.da_mon = 3;
    today.da_day = 11;
    today.da_dow = 5;

    now.ti_hour = 8;
    now.ti_min = 30;
    now.ti_sec = 00;


    for (;;)
    {
        OSTimeDly(OS_TICKS_PER_SEC / 50);               /* 延时20毫秒 */
        if ((IO0PIN & KEY1) != 0)
        {
            continue;
        }
        OSTimeDly(OS_TICKS_PER_SEC / 50);               /* 延时20毫秒 */
        if ((IO0PIN & KEY1) != 0)
        {
            continue;
        }
        setdate(&today);
        settime(&now);
        
        
        getdate(&today);
        gettime(&now);
        today.da_year++;
        now.ti_hour = (now.ti_hour + 1) % 24;
        
        while ((IO0PIN & KEY1) == 0)
        {
            OSTimeDly(OS_TICKS_PER_SEC / 50);           /* 延时20毫秒 */
        }
    }
}
   
/*********************************************************************************************************
**                            End Of File
********************************************************************************************************/
