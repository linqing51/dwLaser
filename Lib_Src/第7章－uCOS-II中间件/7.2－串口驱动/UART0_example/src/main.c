/****************************************Copyright (c)**************************************************
**                               Guangzou ZLG-MCU Development Co.,LTD.
**                                      graduate school
**                                 http://www.zlgmcu.com
**
**--------------File Info-------------------------------------------------------------------------------
** File name:			main.c
** Last modified Date:  2004-09-16
** Last Version:		1.0
** Descriptions:		The main() function example template
**
**------------------------------------------------------------------------------------------------------
** Created by:			Chenmingji
** Created date:		2004-09-16
** Version:				1.0
** Descriptions:		The original version
**
**------------------------------------------------------------------------------------------------------
** Modified by:
** Modified date:
** Version:
** Descriptions:
**
**------------------------------------------------------------------------------------------------------
**文   件   名: test.c
**创   建   人: 陈明计
**最后修改日期: 2003年7月2日
**描        述: 使用串口0接收和发送数据。上位机运行EasyARM软件，在发送数据窗口设置要发送的数据，如ff 80 0 3 0，采
**             用十六进制格式发送(发送的数据要符合EasyARM软件通讯协议)。当LPC2114接收到数据后，会把接收到的数据返
**             回，则在EasyARM软件的数码管上有对应的数字显示。
**--------------历史版本信息----------------------------------------------------------------------------
** 创建人: 陈明计
** 版  本: v1.0
** 日　期: 2003年7月2日
** 描　述: 原始版本
**
**--------------历史版本修订------------------------------------------------------------------------------
** 修改人: 黄绍斌
** 日　期: 2004年3月25日
** 描　述: 在config.h文件中加入包含queue.h、uart0.h，并定义数据队列的配置；
**        在IRQ.S、TARGET.C文件中设置UART0向量中断。
** 说  明: 将JP5短接，将PC的COM1(或COM2)与EasyARM2100开发板的CZ2连接。
**------------------------------------------------------------------------------------------------------
********************************************************************************************************/
/**--------------当前版本修订------------------------------------------------------------------------------
** 修改人: 陈锡炳
** 日　期: 2005-03-07
** 描　述: 修改，以适合EasyARM2131。－使用和以前不同的工程模板。
** 说  明: 
**------------------------------------------------------------------------------------------------------
********************************************************************************************************/

#include "config.h"

#define  TASK_STK_SIZE                  64
OS_STK        TaskStk[TASK_STK_SIZE];
OS_STK        TaskStartStk[TASK_STK_SIZE];

OS_EVENT *Uart0ReviceMbox;

void  TaskStart(void *data);
void  TaskUart0Revice(void *pdata);

/*********************************************************************************************************
** 函数名称: PC_DispChar1
** 功能描述: 从UART0将缓冲区的数据发送出去。共发送5字节数据。
** 输　入: cp		要发送数据的缓冲区指针
** 输　出: 无
** 全局变量: 无
** 调用模块: 
**
** 作　者: 陈明计
** 日　期: 2003年7月1日
**-------------------------------------------------------------------------------------------------------
** 修改人: 
** 日　期: 
**------------------------------------------------------------------------------------------------------
********************************************************************************************************/
        void PC_DispChar1(uint8 *cp)
{
    OS_ENTER_CRITICAL();
    UART0Putch(0xff);
    UART0Putch(*cp++);
    UART0Putch(*cp++);
    UART0Putch(*cp++);
    UART0Putch(*cp++);
    OS_EXIT_CRITICAL();
}


/*********************************************************************************************************
** 函数名称: main
** 功能描述: c语言的主函数，由它启动多任务环境
** 输　入: 无
** 输　出: 无
** 全局变量: 无
** 调用模块: PC_DispClrScr,OSInit,OSTaskCreate,OSStart
**
** 作　者: 陈明计
** 日　期: 2003年7月1日
**-------------------------------------------------------------------------------------------------------
** 修改人: 
** 日　期: 
**------------------------------------------------------------------------------------------------------
********************************************************************************************************/
        int main (void)
{
    OSInit();

    OSTaskCreate(TaskStart, (void *)0, &TaskStartStk[TASK_STK_SIZE - 1], 0);
    OSStart();
    return 0;
}

/*********************************************************************************************************
** 函数名称: TaskStart
** 功能描述: μCOS-II的第一个任务，通常由它初始化目标板和建立其它任务
** 输　入: 无
** 输　出: 无
** 全局变量: 无
** 调用模块: 
**
** 作　者: 陈明计
** 日　期: 2003年7月1日
**-------------------------------------------------------------------------------------------------------
** 修改人: 
** 日　期: 
**------------------------------------------------------------------------------------------------------
********************************************************************************************************/
uint8 const ShowTable[11] = {
      0x3f, 0x06, 0x5b, 0x4f, 0x66, 0x6d, 0x7d, 0x07, 0x7f, 0x6f, 0x00};
//     0     1   2    3    4    5    6    7    8    9    

        void  TaskStart(void *pdata)
{
    uint8 *cp;
    uint8 err;

    pdata = pdata;                                                  /* 避免编译警告 */

    Uart0ReviceMbox = OSMboxCreate(NULL);                           /* 建立邮箱     */
    if (Uart0ReviceMbox == NULL)
    {
        while (1);
    }

    OSTaskCreate(TaskUart0Revice, (void *)0, 
                 &TaskStk[TASK_STK_SIZE - 1], 10);                  /* 创建任务     */

    TargetInit();                                                   /* 目标板初始化 */
    for (;;)
    {
        cp = (uint8 *)OSMboxPend(Uart0ReviceMbox, 0, &err);         /* 接收数据 */
        if (cp[0] == 0x80)
        {                                                           /* led显示 */
            cp[2] = ShowTable[cp[2]];
        }
        else
        {                                                           /* 屏幕显示 */
            cp[2] = cp[2] +'0';
        }
        PC_DispChar1(cp);                                            /* 显示接收到的数据 */
    }
}

/*********************************************************************************************************
** 函数名称: TaskUart0Revice
** 功能描述: μCOS-II的任务
** 输　入: 无
** 输　出: 无
** 全局变量: 无
** 调用模块: 
**
** 作　者: 陈明计
** 日　期: 2003年7月1日
**-------------------------------------------------------------------------------------------------------
** 修改人: 
** 日　期: 
**------------------------------------------------------------------------------------------------------
********************************************************************************************************/
        void  TaskUart0Revice(void *pdata)
{
    uint8 *cp;
    uint8 Buf[4], temp, i;
    
    pdata = pdata;                                                  /* 避免编译警告 */

    for (;;)
    {
err:
        cp = Buf;
        while (UART0Getch() != 0xff);                               /* 接收数据头 */    
        for (i = 0; i < 4; i++)
        {
            temp = UART0Getch();
            if (temp == 0xff)
            {
                goto err;
            }
            *cp++ = temp;
        }
        OSMboxPost(Uart0ReviceMbox, (void *)Buf);
    }
}

/*********************************************************************************************************
**                            End Of File
********************************************************************************************************/
