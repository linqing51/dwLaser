/****************************************Copyright (c)**************************************************
**                               广州周立功单片机发展有限公司
**                                     研    究    所
**                                        ARM开发组
**
**                                 http://www.zlgmcu.com
**
**--------------文件信息--------------------------------------------------------------------------------
**文   件   名: 
**创   建   人: 
**最后修改日期: 
**描        述: 
**              
**注        意：
**              
**--------------历史版本信息----------------------------------------------------------------------------
** 创建人: 
** 版  本: 
** 日　期: 
** 描　述: 
**
**--------------当前版本修订------------------------------------------------------------------------------
** 修改人: 
** 日　期:
** 描　述:
**
**------------------------------------------------------------------------------------------------------
********************************************************************************************************/
#include "config.h"

//#include 	"sdconfig.h"
//#include 	"sddriver.h"

OS_STK        TaskStk[1024];
OS_STK        TaskStartStk[1024];

        char *strupr(char *Str)
{
    char *cp;
    
    cp = Str;
    while (*cp != 0)
    {
        if (*cp >= 'a' && *cp <= 'z' )
        {
            *cp -=  'a' - 'A';
        }
        cp++;
    }
    return Str;
}

/*********************************************************************************************************
** 函数名称: main
** 功能描述: 测试程序主函数
**
** 输　入: 无
**
** 输　出: 无
**         
** 全局变量: 无
** 调用模块: 无
**
** 作　者: 陈明计
** 日　期: 2003年6月5日
**-------------------------------------------------------------------------------------------------------
** 修改人:
** 日　期:
**------------------------------------------------------------------------------------------------------
********************************************************************************************************/
void  TaskStart (void *pdata);
	int main(void)
{
    OSInit();
    OSTaskCreate(TaskStart, (void *)0, &TaskStartStk[1023], 9);
    OSTaskCreate(OSFileTask, (void *)0, &TaskStk[1023], 8);
    OSStart();
    return 0;
}

char *FileName = "a:\\单片机.txt";
char WritFileData[]=
"\r\n******************Copyright (c) 周立功单片机发展有限公司***********************\r\n\
\r\n\
    ZLG/FS是广州周立功单片机发展有限公司开发的面向嵌入式系统开发的小型文件系统，\r\n\
是ZLG系列中间件的重要成员之一。它是与FAT12、FAT16、FAT32高度兼容的文件系统，可以\r\n\
直接与个人电脑交换文件。它是可移植的、可固化的文件系统，可以用于前后台系统，也可\r\n\
用于多任务环境。目前ZLG/FS的最新版本为1.0。\
\r\n\
\r\n*********************************ARM开发部门************************************\r\n";

    void  TaskStart (void *pdata)
{
    HANDLE FHandle;

    pdata = pdata;

	OSAddFileDriver(SDCammand);			/*增加ATA设备0*/

    FHandle = OSFileOpen(FileName, "rw");
    OSFileSeek(FHandle,0, SEEK_END);
    OSFileWrite(WritFileData, sizeof(WritFileData), FHandle);
    OSFileClose(FHandle);
	OSMakeDir("a:\\ARM&FATS");
    OSRemoveDir("dir2.dir");

    OSAllCacheWriteBack();
    OSRemoveFileDriver(0);
    while (1);
}


/*********************************************************************************************************
**                            End Of File
********************************************************************************************************/
