/****************************************Copyright (c)**************************************************
**                               Guangzou ZLG-MCU Development Co.,LTD.
**                                      graduate school
**                                 http://www.zlgmcu.com
**
**--------------File Info-------------------------------------------------------------------------------
** File name:			main.c
** Last modified Date:  2004-09-16
** Last Version:		1.0
** Descriptions:		The main() function example template
**
**------------------------------------------------------------------------------------------------------
** Created by:			Chenmingji
** Created date:		2004-09-16
** Version:				1.0
** Descriptions:		The original version
**
**------------------------------------------------------------------------------------------------------
** Modified by:
** Modified date:
** Version:
** Descriptions:
**
********************************************************************************************************/
/****************************************Copyright (c)**************************************************
**                               广州周立功单片机发展有限公司
**                                     研    究    所
**                                        产品一部 
**
**                                 http://www.zlgmcu.com
**
**--------------文件信息--------------------------------------------------------------------------------
**文   件   名: test.c
**创   建   人: 陈明计
**最后修改日期: 2003年7月7日
**描        述: LPC2114的I2c主方式驱动使用的例子。对CAT1025进行读写操作，若操作正确则LED1点亮，否则LED1闪烁
**             报警。
**--------------历史版本信息----------------------------------------------------------------------------
** 创建人: 陈明计
** 版  本: v1.0
** 日　期: 2003年7月7日
** 描　述: 原始版本
**
**--------------历史版本信------------------------------------------------------------------------------
** 修改人: 黄绍斌
** 日　期: 2004年3月25日
** 描　述: 针对EasyARM2100开发实验板进行修改(BEEP的定义及PINSEL1设置)。
**        在config.h文件中加入包含i2c.h、Myfunction.h，并定义CAT1025器件地址；
**        在IRQ.S、TARGET.C文件中设置I2C向量中断。
** 说  明: 将跳线器JP9、JP4_LED1短接。
**------------------------------------------------------------------------------------------------------
********************************************************************************************************/
/***--------------当前版本修订------------------------------------------------------------------------------
** 修改人: 陈锡炳
** 日　期: 2005-03-08
** 描　述: 用EasyARM2131工程模板建立工程，移除Myfunction.c和Myfunction.h
**         改用BEEP指示操作成功与否。
** 说  明: 跳线器参考EasyARM2131电路.
**------------------------------------------------------------------------------------------------------
********************************************************************************************************/

#include "config.h"

#define  TASK_STK_SIZE             64
OS_STK   TaskStartStk[TASK_STK_SIZE];

#define	  BEEP	(1<<7)		/* P0.7引脚控制BEEP  */


void  TaskStart(void *data);

/*********************************************************************************************************
** 函数名称: main
** 功能描述: c语言的主函数，由它启动多任务环境
** 输　入: 无
** 输　出: 无
** 全局变量: 无
** 调用模块: OSInit,OSTaskCreate,OSStart
**
** 作　者: 陈明计
** 日　期: 2003年7月7日
**-------------------------------------------------------------------------------------------------------
** 修改人: 
** 日　期: 
**------------------------------------------------------------------------------------------------------
********************************************************************************************************/
        int main (void)
{
    OSInit();

    OSTaskCreate(TaskStart, (void *)0, &TaskStartStk[TASK_STK_SIZE - 1], 0);
    OSStart();
    return 0;
}

/*********************************************************************************************************
** 函数名称: TaskStart
** 功能描述: μCOS-II的第一个任务，通常由它初始化目标板和建立其它任务
** 输　入: 无
** 输　出: 无
** 全局变量: 无
** 调用模块: 
**
** 作　者: 陈明计
** 日　期: 2003年7月7日
**-------------------------------------------------------------------------------------------------------
** 修改人: 
** 日　期: 
**------------------------------------------------------------------------------------------------------
********************************************************************************************************/

        void  TaskStart(void *pdata)
{
    uint8 i;
    uint8 DataBuf[11];

    pdata = pdata;                                                  /* 避免编译警告 */

    TargetInit();                                                   /* 目标板初始化 */
    IO0DIR |= BEEP;			                                    /* 设置BEEP控制口为输出 */
    PINSEL0 = (PINSEL0 & 0xffff3fff);
    IO0SET = BEEP;                                                /* 关闭BEEP */
    
    for (i = 0; i < 10; i++)
    {
        DataBuf[i + 1] = i + '0';
    }
    DataBuf[0] = 0;                                                 /* 扩展地址 */
    I2cWrite(CAT1025, DataBuf, 11);

    OSTimeDly(OS_TICKS_PER_SEC / 100 + 1);
    I2cRead(CAT1025, DataBuf, DataBuf, 1, 10);
    for (i = 0; i < 10; i++)
    {
        if (DataBuf[i] != (i + '0'))
        {
            break;
        }
    }
    if ( i < 10)
    {                                                               /* 读写错误 */
        while (1)													/* 连续蜂鸣报警 */
        {
            IO0SET = BEEP;
            OSTimeDly(OS_TICKS_PER_SEC / 10);
            IO0CLR = BEEP;
            OSTimeDly(OS_TICKS_PER_SEC / 10);
        }
        
    }
    else
    {                                                               /* 读写成功 */
        IO0CLR = BEEP;
        OSTimeDly(OS_TICKS_PER_SEC / 2);							/* 蜂鸣器响一声 */
        IO0SET = BEEP;
        while (1);
    }
}
   
/*********************************************************************************************************
**                            End Of File
********************************************************************************************************/
