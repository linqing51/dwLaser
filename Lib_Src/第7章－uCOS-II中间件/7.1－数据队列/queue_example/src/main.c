/****************************************Copyright (c)**************************************************
**                               Guangzou ZLG-MCU Development Co.,LTD.
**                                      graduate school
**                                 http://www.zlgmcu.com
**
**--------------File Info-------------------------------------------------------------------------------
** File name:			main.c
** Last modified Date:  2004-09-16
** Last Version:		1.0
** Descriptions:		The main() function example template
**
**------------------------------------------------------------------------------------------------------
** Created by:			Chenmingji
** Created date:		2004-09-16
** Version:				1.0
** Descriptions:		The original version
**
**------------------------------------------------------------------------------------------------------
** Modified by:
** Modified date:
** Version:
** Descriptions:
**
********************************************************************************************************/
/****************************************Copyright (c)**************************************************
**                               广州周立功单片机发展有限公司
**                                     研    究    所
**                                        产品一部 
**
**                                 http://www.zlgmcu.com
**
**--------------文件信息--------------------------------------------------------------------------------
**文   件   名: test.c
**创   建   人: 陈明计
**最后修改日期: 2003年7月2日
**描        述: 数据队列使用例子。先定义一个数据队列QueueBuf，然后使用一个任务循环向数据队列发送数据，另一任务则
**             从队列中取得数据，转换后向串口发送。使用EasyARM软件的数码管显示输出结果。
**--------------历史版本信息----------------------------------------------------------------------------
** 创建人: 陈明计
** 版  本: v1.0
** 日　期: 2003年7月2日
** 描　述: 原始版本
**
**--------------当前版本修订------------------------------------------------------------------------------
** 修改人: 		陈锡炳
** 日　期:		2005-03-07
** 描　述:		修改，以适合EasyARM2131开发板
**
**------------------------------------------------------------------------------------------------------
********************************************************************************************************/


//在Config.h中增加
/* 数据队列的配置 */
//#define QUEUE_DATA_TYPE           uint8
//#include "queue.h"
//#define EN_QUEUE_WRITE            1     /* 禁止(0)或允许(1)FIFO发送数据       */
//#define EN_QUEUE_WRITE_FRONT      0     /* 禁止(0)或允许(1)LIFO发送数据       */
//#define EN_QUEUE_NDATA            0     /* 禁止(0)或允许(1)取得队列数据数目   */
//#define EN_QUEUE_SIZE             0     /* 禁止(0)或允许(1)取得队列数据总容量 */
//#define EN_QUEUE_FLUSH            0     /* 禁止(0)或允许(1)清空队列           */

//因为需要在EasyARM.exe上显示，因而需要包含PC.c文件。


#include "config.h"

#define  TASK_STK_SIZE                  64
OS_STK        TaskStk[TASK_STK_SIZE];
OS_STK        TaskStartStk[TASK_STK_SIZE];

int32 QueueBuf[15];

void  TaskStart(void *data);
void  Task (void *pdata);

/*********************************************************************************************************
** 函数名称: main
** 功能描述: c语言的主函数，由它启动多任务环境
** 输　入: 无
** 输　出: 无
** 全局变量: 无
** 调用模块: PC_DispClrScr,OSInit,OSTaskCreate,OSStart
**
** 作　者: 陈明计
** 日　期: 2003年7月1日
**-------------------------------------------------------------------------------------------------------
** 修改人: 
** 日　期: 
**------------------------------------------------------------------------------------------------------
********************************************************************************************************/
        int main (void)
{
    OSInit();

    OSTaskCreate(TaskStart, (void *)0, &TaskStartStk[TASK_STK_SIZE - 1], 0);
    OSStart();
    
    return 0;
}

/*********************************************************************************************************
** 函数名称: TaskStart
** 功能描述: μCOS-II的第一个任务，通常由它初始化目标板和建立其它任务
** 输　入: 无
** 输　出: 无
** 全局变量: 无
** 调用模块: 
**
** 作　者: 陈明计
** 日　期: 2003年7月1日
**-------------------------------------------------------------------------------------------------------
** 修改人: 
** 日　期: 
**------------------------------------------------------------------------------------------------------
********************************************************************************************************/
uint8 const ShowTable[11] = {
      0x3f, 0x06, 0x5b, 0x4f, 0x66, 0x6d, 0x7d, 0x07, 0x7f, 0x6f, 0x00};
//     0     1   2    3    4    5    6    7    8    9    

        void  TaskStart (void *pdata)
{
    QUEUE_DATA_TYPE Ch;

    pdata = pdata;                                                  /* 避免编译警告 */

    OSTaskCreate(Task, (void *)0, &TaskStk[TASK_STK_SIZE - 1], 8);  /* 创建任务     */

    TargetInit();                                                   /* 目标板初始化 */
    QueueCreate((void *)QueueBuf, sizeof(QueueBuf), NULL, NULL);    /* 建立数据队列 */
    
    for (;;)
    {
        OSTimeDly(40);                                              /* 延时             */
        if (QueueRead(&Ch, (void *)QueueBuf) == QUEUE_OK)           /* 接收数据         */
        {
            PC_DispChar(0x80, 0, ShowTable[Ch], 0);                 /* 显示接收到的数据 */
        }
    }
}

/*********************************************************************************************************
** 函数名称: Task
** 功能描述: μCOS-II的任务:发送数据
** 输　入: 无
** 输　出: 无
** 全局变量: 无
** 调用模块: 
**
** 作　者: 陈明计
** 日　期: 2003年7月1日
**-------------------------------------------------------------------------------------------------------
** 修改人: 
** 日　期: 
**------------------------------------------------------------------------------------------------------
********************************************************************************************************/
        void  Task (void *pdata)
{
    uint8 i;
    
    pdata = pdata;                                                  /* 避免编译警告 */

    for (;;)
    {
#if EN_QUEUE_WRITE > 0
        for (i = 0; i < 10; i++)
        {
            if (QueueWrite((void *)QueueBuf, i) == QUEUE_FULL)       /* FIFO方式发送数据 */
            {
                i--;                                                /* 错误处理 */
            }
            OSTimeDly(20);                                          /* 延时 */
        }
#endif

#if EN_QUEUE_WRITE_FRONT > 0
        for (i = 0; i < 10; i++)
        {
            if (QueueWriteFront((void *)QueueBuf, i) == QUEUE_FULL)  /* LIFO方式发送数据 */
            {
                                                                    /* 错误处理 */
                OSTimeDly(40);
                i--;
            }
        }
        OSTimeDly(600);
#endif
    }
}

/*********************************************************************************************************
**                            End Of File
********************************************************************************************************/
